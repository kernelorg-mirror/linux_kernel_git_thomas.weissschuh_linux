## arch/x86/tests/Kconfig
```kconfig
# SPDX-License-Identifier: GPL-2.0

config X86_UAPI_TEST
        tristate "x86 UAPI tests" if !KUNIT_ALL_TESTS
        depends on KUNIT_UAPI
        default KUNIT_ALL_TESTS
```

## kernel/time/tests/Kconfig
```kconfig
# SPDX-License-Identifier: GPL-2.0

config TIMER_UAPI_TEST
	tristate "timer UAPI tests" if !KUNIT_ALL_TESTS
	depends on KUNIT_UAPI
	default KUNIT_ALL_TESTS

config TIME_NS_UAPI_TEST
	tristate "time namespaces UAPI tests" if !KUNIT_ALL_TESTS
	depends on KUNIT_UAPI
	depends on TIME_NS
	default KUNIT_ALL_TESTS
```

## lib/vdso/tests/Kconfig
```kconfig
# SPDX-License-Identifier: GPL-2.0

config VDSO_UAPI_TEST
        tristate "vDSO UAPI tests" if !KUNIT_ALL_TESTS
        depends on KUNIT_UAPI
        default KUNIT_ALL_TESTS
```

## modules/Kconfig
```kconfig
config BENCH_MATH64
	tristate "math64 benchmark"
	depends on KUNIT
	depends on !LTO
```
